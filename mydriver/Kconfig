## mydriver/Kconfig
```kconfig
#
# My Bus Devices
#
menu "My Bus Device"

config SCC_BUS
	tristate "MY BUS driver support"
	default m
	help
	  Driver supporting the my bus for sunxi
	  platforms.

config SCC_DEVICE
	tristate "MY Device "
	default m
	help
	  Driver supporting the my bus for sunxi

config SCC_DRIVER
	tristate "MY Driver "
	default m
	help
	  Driver supporting the my bus for sunxi

config SCC_KOBJECT
	tristate "kobject test"
	default m
	help
	  This is a kobject

config SCC_TEST_CHAR
	tristate "char device test"
	default m
	help
	  This is an example for learn char device

endmenu
```
